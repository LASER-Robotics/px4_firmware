## src/examples/px4_simple_appp/Kconfig
```kconfig
menuconfig EXAMPLES_PX4_SIMPLE_APPP
	bool "px4_simple_appp"
	default n
	---help---
		Enable support for px4_simple_appp
```

## src/examples/thrust_control/Kconfig
```kconfig
menuconfig EXAMPLES_THRUST_CONTROL
	bool "thrust_control"
	default n
	---help---
		Implements thrust control for px4
```

## src/examples/thrust_estimate/Kconfig
```kconfig
menuconfig EXAMPLES_THRUST_ESTIMATE
	bool "thrust_estimate"
	default n
	---help---
		Implements thrust estimate for px4
```
